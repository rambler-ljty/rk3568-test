/dts-v1/;
/plugin/;


// 方法1
/*
&{/rk-485-ctl}{
	overlay_node{
		status="okay";
	};

};


*/


// 方法2

&rk_485_ctl{
        overlay_node{
                status="okay";
        };

};






/ {

// 方法3
/*
        fragment@0 {
                target-path = "/rk-485-ctl";

                __overlay__ {

                        overlay_node {
                                status = "okay";
                        };
                };
        };

*/
// 方法4
/*	
        fragment@1 {
                target=<&rk_485_ctl>;

                __overlay__ {

                        overlay_node {
                                status = "okay";
                        };
                };
        };
*/
};



